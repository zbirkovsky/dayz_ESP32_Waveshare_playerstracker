## sdkconfig.defaults
```kconfig
# SPIRAM/PSRAM Configuration for Waveshare ESP32-S3-Touch-LCD-7
CONFIG_SPIRAM=y
CONFIG_SPIRAM_MODE_OCT=y
CONFIG_SPIRAM_SPEED_80M=y

# Allow allocating from PSRAM
CONFIG_SPIRAM_USE_MALLOC=y
CONFIG_SPIRAM_MALLOC_ALWAYSINTERNAL=16384

# LCD needs PSRAM for frame buffer
CONFIG_ESP32S3_DATA_CACHE_64KB=y
CONFIG_ESP32S3_DATA_CACHE_LINE_64B=y

# Enable PSRAM XIP for better performance with bounce buffers
CONFIG_SPIRAM_FETCH_INSTRUCTIONS=y
CONFIG_SPIRAM_RODATA=y

# Auto-restart LCD DMA in VSYNC to recover from any shifts
CONFIG_LCD_RGB_RESTART_IN_VSYNC=y

# HTTPS certificate bundle for API calls
CONFIG_MBEDTLS_CERTIFICATE_BUNDLE=y
CONFIG_MBEDTLS_CERTIFICATE_BUNDLE_DEFAULT_FULL=y

# LVGL Font Configuration - Enable Montserrat fonts for smooth anti-aliased text
CONFIG_LV_FONT_MONTSERRAT_14=y
CONFIG_LV_FONT_MONTSERRAT_18=y
CONFIG_LV_FONT_MONTSERRAT_20=y
CONFIG_LV_FONT_MONTSERRAT_24=y
CONFIG_LV_FONT_MONTSERRAT_28=y
CONFIG_LV_FONT_MONTSERRAT_48=y

# Set default font
CONFIG_LV_FONT_DEFAULT_MONTSERRAT_18=y

# Color depth for RGB565 display
CONFIG_LV_COLOR_DEPTH_16=y

# Memory for LVGL
CONFIG_LV_MEM_SIZE_KILOBYTES=64

# LVGL Filesystem support (for loading images from SD card)
CONFIG_LV_USE_FS_POSIX=y
CONFIG_LV_FS_POSIX_LETTER=83

# LVGL PNG decoder (for map background images)
CONFIG_LV_USE_LODEPNG=y

# Custom partition table for larger app (LVGL fonts)
CONFIG_PARTITION_TABLE_CUSTOM=y
CONFIG_PARTITION_TABLE_CUSTOM_FILENAME="partitions.csv"
CONFIG_PARTITION_TABLE_FILENAME="partitions.csv"

# 16MB flash size
CONFIG_ESPTOOLPY_FLASHSIZE_16MB=y

# FatFS Long File Name support (required for JSON history files)
CONFIG_FATFS_LFN_HEAP=y
CONFIG_FATFS_MAX_LFN=255

# CRITICAL: SD cards use 512-byte sectors, NOT 4096!
# Using wrong sector size causes ESP32 to read/write to wrong locations
CONFIG_FATFS_SECTOR_512=y

# Increase main task stack size (default is 3584, we need more for UI + HTTP)
CONFIG_ESP_MAIN_TASK_STACK_SIZE=16384

# USB OTG TinyUSB Configuration for Mass Storage mode
CONFIG_TINYUSB=y
CONFIG_TINYUSB_MSC_ENABLED=y
CONFIG_TINYUSB_DESC_MANUFACTURER_STRING="DayZ Tracker"
CONFIG_TINYUSB_DESC_PRODUCT_STRING="SD Card Storage"
CONFIG_TINYUSB_DESC_SERIAL_STRING="123456"
CONFIG_TINYUSB_MSC_BUFSIZE=4096
```
